## arch/arm64/configs/stream195x_defconfig
```kconfig
CONFIG_SYSVIPC=y
CONFIG_POSIX_MQUEUE=y
CONFIG_AUDIT=y
CONFIG_NO_HZ_IDLE=y
CONFIG_HIGH_RES_TIMERS=y
CONFIG_BPF_JIT=y
CONFIG_PREEMPT=y
CONFIG_IRQ_TIME_ACCOUNTING=y
CONFIG_BSD_PROCESS_ACCT=y
CONFIG_BSD_PROCESS_ACCT_V3=y
CONFIG_TASKSTATS=y
CONFIG_TASK_DELAY_ACCT=y
CONFIG_TASK_XACCT=y
CONFIG_TASK_IO_ACCOUNTING=y
CONFIG_IKCONFIG=y
CONFIG_IKCONFIG_PROC=y
CONFIG_NUMA_BALANCING=y
CONFIG_CGROUPS=y
CONFIG_MEMCG=y
CONFIG_BLK_CGROUP=y
CONFIG_CGROUP_SCHED=y
CONFIG_CGROUP_PIDS=y
CONFIG_CGROUP_HUGETLB=y
CONFIG_CPUSETS=y
CONFIG_CGROUP_DEVICE=y
CONFIG_CGROUP_CPUACCT=y
CONFIG_CGROUP_PERF=y
CONFIG_NAMESPACES=y
CONFIG_USER_NS=y
CONFIG_RELAY=y
CONFIG_BLK_DEV_INITRD=y
# CONFIG_RD_BZIP2 is not set
# CONFIG_RD_LZMA is not set
# CONFIG_RD_LZO is not set
# CONFIG_RD_LZ4 is not set
CONFIG_EXPERT=y
CONFIG_KALLSYMS_ALL=y
CONFIG_PROFILING=y
CONFIG_ARCH_NXP=y
CONFIG_ARCH_MXC=y
CONFIG_ARM64_VA_BITS_48=y
CONFIG_SCHED_MC=y
CONFIG_NUMA=y
CONFIG_COMPAT=y
# CONFIG_EFI is not set
CONFIG_PM_DEBUG=y
CONFIG_PM_TEST_SUSPEND=y
CONFIG_WQ_POWER_EFFICIENT_DEFAULT=y
CONFIG_CPU_IDLE=y
CONFIG_ARM_PSCI_CPUIDLE=y
CONFIG_CPU_FREQ=y
CONFIG_CPU_FREQ_STAT=y
CONFIG_CPU_FREQ_DEFAULT_GOV_ONDEMAND=y
CONFIG_CPU_FREQ_GOV_POWERSAVE=y
CONFIG_CPU_FREQ_GOV_USERSPACE=y
CONFIG_CPU_FREQ_GOV_CONSERVATIVE=y
CONFIG_CPU_FREQ_GOV_SCHEDUTIL=y
CONFIG_CPUFREQ_DT=y
CONFIG_ARM_SCPI_CPUFREQ=y
CONFIG_ARM_IMX_CPUFREQ_DT=y
CONFIG_JUMP_LABEL=y
CONFIG_MODULES=y
CONFIG_MODULE_UNLOAD=y
CONFIG_BLK_DEV_INTEGRITY=y
CONFIG_PARTITION_ADVANCED=y
CONFIG_MAC_PARTITION=y
CONFIG_CMDLINE_PARTITION=y
# CONFIG_CORE_DUMP_DEFAULT_ELF_HEADERS is not set
# CONFIG_COMPAT_BRK is not set
CONFIG_KSM=y
CONFIG_MEMORY_FAILURE=y
CONFIG_CMA=y
CONFIG_NET=y
CONFIG_PACKET=y
CONFIG_UNIX=y
CONFIG_INET=y
CONFIG_IP_MULTICAST=y
CONFIG_IP_PNP=y
CONFIG_IP_PNP_DHCP=y
CONFIG_IP_PNP_BOOTP=y
# CONFIG_IPV6_SIT is not set
CONFIG_NETFILTER=y
CONFIG_NETFILTER_NETLINK_LOG=y
CONFIG_NF_CONNTRACK=y
CONFIG_NETFILTER_XT_TARGET_LOG=y
CONFIG_NETFILTER_XT_MATCH_COMMENT=y
CONFIG_NETFILTER_XT_MATCH_CONNTRACK=y
CONFIG_NETFILTER_XT_MATCH_MULTIPORT=y
CONFIG_IP_NF_IPTABLES=y
CONFIG_IP_NF_FILTER=y
CONFIG_IP_NF_TARGET_REJECT=y
CONFIG_IP6_NF_IPTABLES=y
CONFIG_IP6_NF_FILTER=y
CONFIG_IP6_NF_TARGET_REJECT=y
CONFIG_LLC2=y
CONFIG_BT=y
CONFIG_BT_RFCOMM=y
CONFIG_BT_RFCOMM_TTY=y
CONFIG_BT_BNEP=y
CONFIG_BT_BNEP_MC_FILTER=y
CONFIG_BT_BNEP_PROTO_FILTER=y
CONFIG_BT_HIDP=y
# CONFIG_BT_LE is not set
CONFIG_BT_HCIUART=y
CONFIG_BT_HCIUART_H4=y
CONFIG_CFG80211=y
CONFIG_NL80211_TESTMODE=y
CONFIG_CFG80211_WEXT=y
CONFIG_MAC80211=y
CONFIG_PCI=y
CONFIG_PCI_HOST_GENERIC=y
CONFIG_DEVTMPFS=y
CONFIG_DEVTMPFS_MOUNT=y
CONFIG_BRCMSTB_GISB_ARB=y
CONFIG_VEXPRESS_CONFIG=y
CONFIG_ARM_SCPI_PROTOCOL=y
CONFIG_IMX_DSP=y
CONFIG_IMX_SCU=y
CONFIG_BLK_DEV_LOOP=y
CONFIG_SRAM=y
CONFIG_SCSI=y
# CONFIG_SCSI_PROC_FS is not set
CONFIG_BLK_DEV_SD=y
CONFIG_BLK_DEV_SR=y
CONFIG_SCSI_SAS_LIBSAS=y
CONFIG_NETDEVICES=y
# CONFIG_NET_VENDOR_ALACRITECH is not set
# CONFIG_NET_VENDOR_AMAZON is not set
# CONFIG_NET_VENDOR_AMD is not set
# CONFIG_NET_VENDOR_AQUANTIA is not set
# CONFIG_NET_VENDOR_ARC is not set
# CONFIG_NET_VENDOR_BROADCOM is not set
# CONFIG_NET_VENDOR_CADENCE is not set
# CONFIG_NET_VENDOR_CAVIUM is not set
# CONFIG_NET_VENDOR_CORTINA is not set
# CONFIG_NET_VENDOR_EZCHIP is not set
CONFIG_FEC=y
CONFIG_FEC_UIO=y
# CONFIG_NET_VENDOR_GOOGLE is not set
# CONFIG_NET_VENDOR_HISILICON is not set
# CONFIG_NET_VENDOR_HUAWEI is not set
# CONFIG_NET_VENDOR_INTEL is not set
# CONFIG_NET_VENDOR_MARVELL is not set
# CONFIG_NET_VENDOR_MELLANOX is not set
# CONFIG_NET_VENDOR_MICREL is not set
# CONFIG_NET_VENDOR_MICROCHIP is not set
# CONFIG_NET_VENDOR_MICROSEMI is not set
# CONFIG_NET_VENDOR_NI is not set
# CONFIG_NET_VENDOR_NATSEMI is not set
# CONFIG_NET_VENDOR_NETRONOME is not set
# CONFIG_NET_VENDOR_PENSANDO is not set
# CONFIG_NET_VENDOR_QUALCOMM is not set
# CONFIG_NET_VENDOR_RENESAS is not set
# CONFIG_NET_VENDOR_ROCKER is not set
# CONFIG_NET_VENDOR_SAMSUNG is not set
# CONFIG_NET_VENDOR_SEEQ is not set
# CONFIG_NET_VENDOR_SOLARFLARE is not set
# CONFIG_NET_VENDOR_SMSC is not set
# CONFIG_NET_VENDOR_SOCIONEXT is not set
# CONFIG_NET_VENDOR_STMICRO is not set
# CONFIG_NET_VENDOR_SYNOPSYS is not set
# CONFIG_NET_VENDOR_VIA is not set
# CONFIG_NET_VENDOR_WIZNET is not set
CONFIG_MICROCHIP_PHY=y
CONFIG_MICROSEMI_PHY=y
CONFIG_MDIO_BITBANG=y
CONFIG_MDIO_BUS_MUX_MULTIPLEXER=y
CONFIG_MDIO_BUS_MUX_MMIOREG=y
# CONFIG_USB_NET_DRIVERS is not set
# CONFIG_WLAN is not set
CONFIG_INPUT_MATRIXKMAP=y
CONFIG_INPUT_EVDEV=y
CONFIG_KEYBOARD_GPIO=y
CONFIG_KEYBOARD_SNVS_PWRKEY=y
CONFIG_INPUT_TOUCHSCREEN=y
# CONFIG_TOUCHSCREEN_CT36X_WLD is not set
CONFIG_TOUCHSCREEN_GOODIX=y
# CONFIG_TOUCHSCREEN_SYNAPTICS_DSX is not set
CONFIG_INPUT_MISC=y
CONFIG_INPUT_UINPUT=y
# CONFIG_SERIO_SERPORT is not set
CONFIG_SERIO_AMBAKMI=y
CONFIG_LEGACY_PTY_COUNT=16
CONFIG_SERIAL_8250=y
CONFIG_SERIAL_8250_CONSOLE=y
CONFIG_SERIAL_8250_EXTENDED=y
CONFIG_SERIAL_8250_SHARE_IRQ=y
CONFIG_SERIAL_IMX=y
CONFIG_SERIAL_IMX_CONSOLE=y
CONFIG_SERIAL_DEV_BUS=y
CONFIG_I2C_CHARDEV=y
CONFIG_I2C_IMX=y
CONFIG_I2C_IMX_LPI2C=y
CONFIG_I2C_RPBUS=y
CONFIG_SPI=y
CONFIG_SPI_IMX=y
CONFIG_SPI_SPIDEV=y
CONFIG_PINCTRL=y
CONFIG_PINCTRL_SINGLE=y
CONFIG_PINCTRL_IMX8MM=y
CONFIG_GPIO_SYSFS=y
CONFIG_GPIO_GENERIC_PLATFORM=y
CONFIG_GPIO_MXC=y
CONFIG_POWER_RESET_SYSCON=y
CONFIG_POWER_RESET_SYSCON_POWEROFF=y
CONFIG_SENSORS_ARM_SCPI=y
CONFIG_THERMAL=y
CONFIG_THERMAL_WRITABLE_TRIPS=y
CONFIG_CPU_THERMAL=y
CONFIG_THERMAL_EMULATION=y
CONFIG_IMX8MM_THERMAL=y
CONFIG_DEVICE_THERMAL=y
CONFIG_WATCHDOG=y
CONFIG_IMX2_WDT=y
# CONFIG_MFD_VEXPRESS_SYSREG is not set
CONFIG_REGULATOR=y
CONFIG_REGULATOR_FIXED_VOLTAGE=y
CONFIG_REGULATOR_AXP15060=y
CONFIG_MEDIA_CEC_SUPPORT=y
CONFIG_MEDIA_SUPPORT=y
CONFIG_MEDIA_SUPPORT_FILTER=y
CONFIG_MEDIA_SUBDRV_AUTOSELECT=y
CONFIG_IMX8MM_LCDIF_CORE=y
CONFIG_DRM=y
CONFIG_DRM_PANEL_KINGTECH_PV04005TD25E=y
CONFIG_DRM_I2C_ADV7511=y
CONFIG_DRM_IMX=y
CONFIG_DRM_IMX_LCDIF_MUX_DISPLAY=y
CONFIG_DRM_IMX_PARALLEL_DISPLAY=y
CONFIG_DRM_IMX_TVE=y
CONFIG_DRM_IMX_LDB=y
CONFIG_DRM_IMX_HDMI=y
CONFIG_DRM_IMX_SEC_DSIM=y
CONFIG_DRM_IMX_CDNS_MHDP=y
CONFIG_DRM_IMX_LCDIF=y
CONFIG_FB=y
CONFIG_LCD_CLASS_DEVICE=y
CONFIG_BACKLIGHT_CLASS_DEVICE=y
CONFIG_BACKLIGHT_PWM=y
CONFIG_SOUND=y
CONFIG_SND=y
# CONFIG_SND_USB is not set
CONFIG_SND_SOC=y
CONFIG_SND_SOC_FSL_MICFIL=y
CONFIG_SND_IMX_SOC=y
CONFIG_SND_SOC_IMX_SPDIF=y
CONFIG_SND_SOC_SOF_TOPLEVEL=y
CONFIG_SND_SOC_SOF_OF=y
CONFIG_SND_SOC_SOF_IMX_TOPLEVEL=y
CONFIG_SND_SOC_SOF_IMX8=y
CONFIG_SND_SOC_SOF_IMX8M=y
CONFIG_SND_SOC_STREAM195X=y
CONFIG_SND_SOC_AK4458=y
CONFIG_SND_SOC_SPDIF=y
CONFIG_SND_SOC_TLV320ADCX140=y
CONFIG_SND_SIMPLE_CARD=y
CONFIG_UHID=y
CONFIG_HID_A4TECH=y
CONFIG_HID_APPLE=y
CONFIG_HID_BELKIN=y
CONFIG_HID_CHERRY=y
CONFIG_HID_CHICONY=y
CONFIG_HID_CYPRESS=y
CONFIG_HID_EZKEY=y
CONFIG_HID_ITE=y
CONFIG_HID_KENSINGTON=y
CONFIG_HID_REDRAGON=y
CONFIG_HID_MICROSOFT=y
CONFIG_HID_MONTEREY=y
CONFIG_I2C_HID_OF=m
CONFIG_USB=y
CONFIG_USB_OTG=y
CONFIG_USB_XHCI_HCD=y
CONFIG_USB_XHCI_PLATFORM=y
CONFIG_USB_EHCI_HCD=y
CONFIG_USB_EHCI_HCD_PLATFORM=y
CONFIG_USB_OHCI_HCD=y
CONFIG_USB_OHCI_HCD_PLATFORM=y
CONFIG_USB_HCD_TEST_MODE=y
CONFIG_USB_ACM=y
CONFIG_USB_STORAGE=y
CONFIG_USB_UAS=y
CONFIG_USB_CHIPIDEA=y
CONFIG_USB_CHIPIDEA_UDC=y
CONFIG_USB_CHIPIDEA_HOST=y
CONFIG_USB_SERIAL=y
CONFIG_USB_SERIAL_GENERIC=y
CONFIG_USB_SERIAL_CP210X=y
CONFIG_USB_SERIAL_FTDI_SIO=y
CONFIG_USB_SERIAL_PL2303=y
CONFIG_USB_EHSET_TEST_FIXTURE=y
CONFIG_NOP_USB_XCEIV=y
CONFIG_USB_ULPI=y
CONFIG_USB_GADGET=y
CONFIG_USB_SNP_UDC_PLAT=y
CONFIG_USB_BDC_UDC=y
CONFIG_USB_CONFIGFS=y
CONFIG_USB_CONFIGFS_F_UAC2=y
CONFIG_USB_MASS_STORAGE=m
CONFIG_MMC=y
CONFIG_MMC_BLOCK_MINORS=32
CONFIG_MMC_ARMMMCI=y
# CONFIG_MMC_STM32_SDMMC is not set
CONFIG_MMC_SDHCI=y
CONFIG_MMC_SDHCI_PLTFM=y
CONFIG_MMC_SDHCI_ESDHC_IMX=y
CONFIG_NEW_LEDS=y
CONFIG_LEDS_CLASS=y
CONFIG_RTC_CLASS=y
CONFIG_RTC_DRV_SNVS=y
CONFIG_DMADEVICES=y
CONFIG_IMX_SDMA=m
# CONFIG_MX3_IPU is not set
# CONFIG_VIRTIO_MENU is not set
CONFIG_COMMON_CLK_SCPI=y
CONFIG_CLK_IMX8MM=y
CONFIG_HWSPINLOCK=y
CONFIG_MAILBOX=y
CONFIG_ARM_MHU=y
CONFIG_IMX_MBOX=y
CONFIG_PLATFORM_MHU=y
CONFIG_ARM_SMMU=y
CONFIG_ARM_SMMU_V3=y
CONFIG_RPMSG_CHAR=y
# CONFIG_IMX8M_BUSFREQ is not set
CONFIG_EXTCON_USB_GPIO=y
CONFIG_PWM=y
CONFIG_PWM_IMX27=y
# CONFIG_IMX_IRQSTEER is not set
CONFIG_RESET_IMX7=y
CONFIG_GENERIC_PHY=y
# CONFIG_PHY_FSL_IMX8MQ_USB is not set
CONFIG_FSL_IMX8_DDR_PMU=y
CONFIG_NVMEM_IMX_OCOTP=y
CONFIG_TEE=y
CONFIG_OPTEE=y
# CONFIG_MXC_HANTRO is not set
# CONFIG_MXC_HANTRO_845 is not set
# CONFIG_MXC_HANTRO_845_H1 is not set
# CONFIG_MXC_HANTRO_VC8000E is not set
CONFIG_EXT2_FS=y
CONFIG_EXT3_FS=y
CONFIG_EXT4_FS_POSIX_ACL=y
CONFIG_EXT4_FS_SECURITY=y
CONFIG_FANOTIFY=y
CONFIG_FANOTIFY_ACCESS_PERMISSIONS=y
CONFIG_QUOTA=y
CONFIG_AUTOFS4_FS=y
CONFIG_FUSE_FS=y
CONFIG_VFAT_FS=y
CONFIG_EXFAT_FS=y
CONFIG_NTFS_FS=y
CONFIG_TMPFS=y
CONFIG_HUGETLBFS=y
CONFIG_HFS_FS=y
CONFIG_HFSPLUS_FS=y
CONFIG_PSTORE=y
# CONFIG_PSTORE_DEFLATE_COMPRESS is not set
CONFIG_PSTORE_RAM=y
CONFIG_NFS_FS=y
CONFIG_NFS_V4=y
CONFIG_NFS_V4_1=y
CONFIG_NFS_V4_2=y
CONFIG_ROOT_NFS=y
CONFIG_SUNRPC_DEBUG=y
CONFIG_NLS_CODEPAGE_437=y
CONFIG_NLS_ISO8859_1=y
CONFIG_SECURITY=y
# CONFIG_INTEGRITY is not set
CONFIG_CRYPTO_USER=y
CONFIG_CRYPTO_BLOWFISH=m
CONFIG_CRYPTO_CAMELLIA=m
CONFIG_CRYPTO_CAST5=m
CONFIG_CRYPTO_CAST6=m
CONFIG_CRYPTO_DES=y
CONFIG_CRYPTO_FCRYPT=m
CONFIG_CRYPTO_SERPENT=m
CONFIG_CRYPTO_TWOFISH=m
CONFIG_CRYPTO_CBC=y
CONFIG_CRYPTO_CFB=y
CONFIG_CRYPTO_CTS=m
CONFIG_CRYPTO_LRW=m
CONFIG_CRYPTO_OFB=m
CONFIG_CRYPTO_PCBC=m
CONFIG_CRYPTO_CHACHA20POLY1305=y
CONFIG_CRYPTO_ECHAINIV=y
CONFIG_CRYPTO_ESSIV=m
CONFIG_CRYPTO_TLS=y
CONFIG_CRYPTO_MD4=m
CONFIG_CRYPTO_MD5=m
CONFIG_CRYPTO_MICHAEL_MIC=y
CONFIG_CRYPTO_RMD160=m
CONFIG_CRYPTO_STREEBOG=m
CONFIG_CRYPTO_VMAC=m
CONFIG_CRYPTO_WP512=m
CONFIG_CRYPTO_XCBC=m
CONFIG_CRYPTO_DEFLATE=y
CONFIG_CRYPTO_LZO=y
CONFIG_CRYPTO_ZSTD=y
CONFIG_CRYPTO_ANSI_CPRNG=y
CONFIG_CRYPTO_USER_API_HASH=y
CONFIG_CRYPTO_USER_API_SKCIPHER=y
CONFIG_CRYPTO_CHACHA20_NEON=m
CONFIG_CRYPTO_GHASH_ARM64_CE=y
CONFIG_CRYPTO_SHA1_ARM64_CE=y
CONFIG_CRYPTO_SHA2_ARM64_CE=y
CONFIG_CRYPTO_SHA512_ARM64_CE=m
CONFIG_CRYPTO_SHA3_ARM64=m
CONFIG_CRYPTO_SM3_ARM64_CE=m
CONFIG_CRYPTO_AES_ARM64_CE_BLK=y
CONFIG_CRYPTO_AES_ARM64_BS=m
CONFIG_CRYPTO_AES_ARM64_CE_CCM=y
CONFIG_CRYPTO_CRCT10DIF_ARM64_CE=m
CONFIG_CRYPTO_DEV_FSL_CAAM_SECVIO=y
CONFIG_CRYPTO_DEV_FSL_CAAM=y
CONFIG_CRYPTO_DEV_FSL_CAAM_SM_TEST=m
CONFIG_INDIRECT_PIO=y
CONFIG_CRC_ITU_T=y
CONFIG_CRC7=y
CONFIG_DMA_CMA=y
CONFIG_CMA_SIZE_MBYTES=32
CONFIG_PRINTK_TIME=y
CONFIG_MAGIC_SYSRQ=y
# CONFIG_MAGIC_SYSRQ_SERIAL is not set
# CONFIG_SCHED_DEBUG is not set
# CONFIG_DEBUG_PREEMPT is not set
# CONFIG_FTRACE is not set
# CONFIG_RUNTIME_TESTING_MENU is not set
CONFIG_MEMTEST=y
```

## arch/mips/Kconfig.formosa
```kconfig
#
# Realtek Semiconductor Corp.
#
# RLX Linux Kernel Configuration
#
# Tony Wu (tonywu@realtek.com)
# Dec. 07, 2008
#

source "formosa/config.top"
source "formosa/config.soc"

#
# MIPS
#
config SHEIPA
	bool
	default y
	select SYS_SUPPORTS_LITTLE_ENDIAN if SOC_CPU_EL
	select SYS_SUPPORTS_BIG_ENDIAN if SOC_CPU_EB
	select IRQ_ICTL if SOC_ENABLE_ICTL
	select CPU_MIPSR2_IRQ_VI if SOC_ENABLE_IRQ_VI
	select CPU_MIPSR2_IRQ_EI if SOC_ENABLE_IRQ_EI
	select HW_HAS_PCI if SOC_ENABLE_PCI
	select HW_HAS_USB if SOC_ENABLE_USB
	select SMP if SOC_ENABLE_SMP
	select DMA_COHERENT if SOC_ENABLE_IOCU
	select DMA_NONCOHERENT if !SOC_ENABLE_IOCU
	select CPU_HAS_EMU if SOC_ENABLE_EMU
	select CPU_HAS_DSP if SOC_ENABLE_DSP
	select CPU_HAS_RADIAX if SOC_ENABLE_RADIAX
	select HARDWARE_WATCHPOINTS if SOC_ENABLE_WATCH
	select USE_OF if SOC_ENABLE_OF
	select BUILTIN_DTB if SOC_ENABLE_BUILTIN_DTB
	select CPU_HAS_L2C if SOC_ENABLE_L2C
	select CPU_MIPS32_R2 if SOC_CPU_MIPS
	select CPU_RLX if SOC_CPU_RLX
	select HAS_DMA

#
# CPU
#
config CPU_MIPS4K
	bool
	default y if SOC_CPU_MIPS4K
	select SYS_HAS_CPU_MIPS32_R2

config CPU_MIPS24K
	bool
	default y if SOC_CPU_MIPS24K
	select SYS_HAS_CPU_MIPS32_R2
	select CPU_HAS_TLS

config CPU_MIPS34K
	bool
	default y if SOC_CPU_MIPS34K
	select SYS_HAS_CPU_MIPS32_R2
	select CPU_HAS_TLS
	select SYS_SUPPORTS_MULTITHREADING
	select SYS_SUPPORTS_SMP
	select MIPS_MT_SMP if SOC_ENABLE_SMP

config CPU_MIPS74K
	bool
	default y if SOC_CPU_MIPS74K
	select SYS_HAS_CPU_MIPS32_R2
	select CPU_HAS_TLS

config CPU_MIPS1004K
	bool
	default y if SOC_CPU_MIPS1004K
	select SYS_HAS_CPU_MIPS32_R2
	select CPU_HAS_TLS
	select SYS_SUPPORTS_SMP
	select SYS_SUPPORTS_MULTITHREADING
	select SYS_SUPPORTS_MIPS_CMP
	select SYS_SUPPORTS_MIPS_CPS
	select MIPS_GIC
	select MIPS_CMP if SOC_ENABLE_CMP
	select MIPS_CPS if SOC_ENABLE_CPS
	select MIPS_MT_SMP if SOC_ENABLE_MT
	select CLKSRC_MIPS_GIC
	select COMMON_CLK

config CPU_MIPS1074K
	bool
	default y if SOC_CPU_MIPS1074K
	select SYS_HAS_CPU_MIPS32_R2
	select CPU_HAS_TLS
	select SYS_SUPPORTS_SMP
	select SYS_SUPPORTS_MIPS_CMP
	select SYS_SUPPORTS_MIPS_CPS
	select MIPS_GIC
	select MIPS_CMP if SOC_ENABLE_CMP
	select MIPS_CPS if SOC_ENABLE_CPS
	select CLKSRC_MIPS_GIC
	select COMMON_CLK

config CPU_MIPSIA
	bool
	default y if SOC_CPU_MIPSIA
	select SYS_HAS_CPU_MIPS32_R2
	select CPU_HAS_TLS
	select SYS_SUPPORTS_SMP
	select SYS_SUPPORTS_MULTITHREADING
	select SYS_SUPPORTS_MIPS_CMP
	select SYS_SUPPORTS_MIPS_CPS
	select MIPS_GIC
	select MIPS_CMP if SOC_ENABLE_CMP
	select MIPS_CPS if SOC_ENABLE_CPS
	select CLKSRC_MIPS_GIC
	select COMMON_CLK

config CPU_RLX4181
	bool
	default y if SOC_CPU_RLX4181
	select SYS_HAS_CPU_RLX

config CPU_RLX5181
	bool
	default y if SOC_CPU_RLX5181
	select SYS_HAS_CPU_RLX
	select CPU_HAS_CLS

config CPU_RLX4281
	bool
	default y if SOC_CPU_RLX4281 || SOC_CPU_RLX4381
	default y if SOC_CPU_RLX4271 || SOC_CPU_RLX4371
	select SYS_HAS_CPU_RLX
	select CPU_HAS_TLS
	select SYS_SUPPORTS_SMP if SOC_ENABLE_SMP
	select SYS_SUPPORTS_TAROKO_CMP if SOC_ENABLE_SMP
	select TAROKO_GIC if SOC_ENABLE_SMP
	select TAROKO_CMP if SOC_ENABLE_SMP

config CPU_RLX5281
	bool
	default y if SOC_CPU_RLX5281 || SOC_CPU_RLX5381
	default y if SOC_CPU_RLX5271 || SOC_CPU_RLX5371
	select SYS_HAS_CPU_RLX
	select CPU_HAS_CLS
	select CPU_HAS_TLS
	select SYS_SUPPORTS_SMP if SOC_ENABLE_SMP
	select SYS_SUPPORTS_TAROKO_CMP if SOC_ENABLE_SMP
	select TAROKO_GIC if SOC_ENABLE_SMP
	select TAROKO_CMP if SOC_ENABLE_SMP

#
# CPU features
#
config CPU_HAS_DSP
	bool

config CPU_HAS_EMU
	bool

config CPU_HAS_CLS
	bool

config CPU_HAS_TLS
	bool

config CPU_HAS_RADIAX
	bool

config CPU_HAS_SLEEP
	bool

#
# IRQ
#
config IRQ_ICTL
	bool

#
# CACHE
#
config CPU_HAS_SPRAM
	bool

config CPU_HAS_WBC
	bool
	default y

config CPU_HAS_L2C
	bool

config CPU_HAS_AR7
	bool

config CPU_HAS_WBIC
	bool
	default y if SOC_CACHE_WBIC

#
# BUS
#
config HW_HAS_USB
	bool
```

## arch/riscv/Kconfig.formosa
```kconfig
# RLX Linux Kernel Configuration
#
# Tony Wu (tonywu@realtek.com)
# Dec. 07, 2008
#

source "formosa/config.top"
source "formosa/config.soc"

#
# RISCV
#
config SHEIPA
	bool
	default y
	select SMP if SOC_ENABLE_SMP

#
# CPU
#
config CPU_TR9
	bool
	default y if SOC_CPU_TR9
	select ARCH_RV32I
	select REALTEK_PLIC if SOC_ENABLE_PLIC
	select REALTEK_CLIC if SOC_ENABLE_CLIC
	select SYS_SUPPORTS_SMP if SOC_ENABLE_SMP

#
# IRQ
#
config REALTEK_PLIC
	bool
	default n

config REALTEK_CLIC
	bool
	default n
	select RISCV_CLIC

config RISCV_CLIC
	bool
	default n
```

## drivers/rtkdrivers/cpufreq/Kconfig
```kconfig
# SPDX-License-Identifier: GPL-2.0-only

config CPUFREQ_RTK_AMEBA
	tristate "CPU freq driver"
	help
	  This adds the CPUFreq driver support for Realtek Ameba SoCs
	  which are capable of changing the CPU's frequency dynamically.
```
