## drivers/rtkdrivers/drm/Kconfig
```kconfig
# SPDX-License-Identifier: GPL-2.0-only
#
# Drm device configuration
#
# This driver provides support for the
# Direct Rendering Infrastructure (DRI) in XFree86 4.1.0 and higher.
#

config DRM_RTK_AMEBA
	tristate "DRM driver"
	select DRM
	select DRM_KMS_HELPER
	select DRM_GEM_CMA_HELPER
	select DRM_KMS_CMA_HELPER
	select DRM_MIPI_DSI
	default n
	help
	  Ameba DRM Kernel Mode-Setting , used for LCDC MIPI DRM support 
	  If M is selected the module will be called drm.
```

## drivers/rtkdrivers/drm/panel/Kconfig
```kconfig
# SPDX-License-Identifier: GPL-2.0-only

config PANEL_ST7701S
	tristate "DRM support for ST7701S display panels"
	depends on OF
	depends on DRM_DSI_RTK_AMEBA
	select VIDEOMODE_HELPERS
	select DRM_PANEL
	default n
	help
	  DRM driver for the following ST7701S panels

config PANEL_R63353
	tristate "DRM support for Synaptics R63353 display panels"
	depends on OF
	depends on DRM_DSI_RTK_AMEBA
	select VIDEOMODE_HELPERS
	select DRM_PANEL
	default n
	help
	  DRM driver for the following Synaptics R63353 panels
```

## drivers/rtkdrivers/km4_console/Kconfig
```kconfig
config KM4_CONSOLE_CORE_AMEBA
	tristate "KM4 Console Core"
	help
	  Core for Realtek KM4 Console

config KM4_CONSOLE_CDEV_AMEBA
	tristate "KM4 Console Character Device"
	select KM4_CONSOLE_CORE_AMEBA
	help
	  Character device driver for Realtek KM4 Console
```

## drivers/rtkdrivers/misc/Kconfig
```kconfig
config MISC_RTK_AMEBA
	tristate "Misc ioctl driver"
	select KM4_CONSOLE_CORE_AMEBA
	help
		This enables the miscellaneous ioctl affairs.
```

## drivers/rtkdrivers/net/wireless/cfg80211_inic/rtl8730e/Kconfig
```kconfig
# SPDX-License-Identifier: GPL-2.0
config NIC_RTK_RTL8730E
	tristate "RTL8730E"
	---help---
	  Realtek RTL8730E driver.
	  802.11 a/b/g/n/ac/ax AXI wireless network adapter
```

## drivers/rtkdrivers/net/wireless/cfg80211_wifi/Kconfig
```kconfig
# SPDX-License-Identifier: GPL-2.0
menuconfig WIFI_RTK_CFG80211
    tristate "CFG80211 WiFi drivers"

if WIFI_RTK_CFG80211

source "drivers/rtkdrivers/net/wireless/cfg80211_wifi/rtl8730a/Kconfig"
source "drivers/rtkdrivers/net/wireless/cfg80211_wifi/rtl8730e/Kconfig"

endif
```

## drivers/rtkdrivers/net/wireless/cfg80211_wifi/rtl8730a/Kconfig
```kconfig
# SPDX-License-Identifier: GPL-2.0
config NIC_RTK_RTL8730A
	tristate "RTL8730A"
	---help---
	  Realtek RTL8730A driver, no support AX.
	  802.11b/g/n AXI wireless network adapter
```

## drivers/rtkdrivers/otp/Kconfig
```kconfig
menuconfig OTP_RTK_AMEBA_CORE
	tristate "OTP"
	help
	  Driver for Realtek OTP core

if OTP_RTK_AMEBA_CORE
config OTP_RTK_AMEBA_CDEV
	tristate "OTP for userspace"
	help
		This enables the OTP for userspace.
endif
```

## drivers/rtkdrivers/spi/Kconfig
```kconfig
config SPI_RTK_AMEBA
	tristate "SPI general controller driver"
	select HAS_IOMEM
	select SPI
	select SPI_SPIDEV
	select SPI_SLAVE
	help
	  This is the driver for the Realtek SPI Controller.
```

## sound/soc/streamunlimited/Kconfig
```kconfig
config SND_SOC_STREAM195X
	tristate "Audio support for Stream195x based board designs"
	select SND_SOC_IMX_PCM_DMA
	select SND_SOC_FSL_SAI
	select SND_SOC_FSL_UTILS
	depends on OF_GPIO && GPIOLIB && SND_SIMPLE_CARD_UTILS
	help
	  Audio support for Stream195x based board designs.
```
