## Documentation/devicetree/bindings/display/bridge/levetop,lt7381.txt
```
Levetop LT7381 SPI display bridge bindings

Required properties:
  - compatible: "levetop,lt7381"
  - reg: Address of this bridge on the SPI bus.
  - rotate: Panel installed orientation.
  - width: Panel width [pixel counts] in accordance to its orientation.
  - height: Panel height [pixel counts] in accordance to its orientation.
  - reset-gpios: OF device-tree gpio specification for RST pin
                (active low system reset)
  - xtal-frequency: OF device-tree specification for XIN pins ref.
                    (Typical value is 10 Mhz)
  - pwm-count: = pwm period [clock cycles]
    d presents the duty cycle [percentage], which is also the current brightness
    level.

    [Fig. 1]
    0%              100%
            +-------+
            |       |
     <----->|<----->|
      100-d |   d   |
    +-------+       +
    <--------------->
        pwm-count

  - backlight-max-brightness: The maximum brightness [percentage].
    It is also the maximum duty cycle [d-max] from [Fig. 1].
  - backlight-default-brightness: The reset brightness on startup
  - display-timings: timings for the connected display according to [1]

The panel must obey rules for SPI slave device specified in document [2].

Optional properties:
  - bgr: when pixel format is bgr
  - test-patern: Enables the test pattern. The panel will only display the
                 generated test pattern, independent of the SDRAM.

[1]: Documentation/devicetree/bindings/display/panel/display-timing.txt
[2]: Documentation/devicetree/bindings/spi/spi-bus.txt

Example:
	lvtop-bridge: spi@0 {
		compatible = "levetop,lt7381";
		status = "okay";
		reg = <0>;
		spi-max-frequency = <32000000>;
		spi-cpol;
		spi-cpha;
		buswidth = <8>;
		rotate = <0>;
		width = <320>;
		height = <240>;
		bgr;
		reset-gpios = <&gpio GPIOA_18 GPIO_ACTIVE_LOW>;
		xtal-frequency = <10000000>;
		pwm-count = <1800>;
		backlight-max-brightness = <90>;
		backlight-default-brightness = <75>;
		test-pattern;

		display-timings {

			display-panel: display-panel {
				clock-frequency = <13700000>;
				hactive = <320>;
				vactive = <240>;
				hback-porch = <38>;
				hsync-len = <30>;
				hfront-porch = <20>;
				vback-porch = <15>;
				vsync-len = <3>;
				vfront-porch = <4>;
				hsync-active = <0>;
				vsync-active = <0>;
				de-active = <1>;
				pixelclk-active = <0>;
			};
		};
	};
```

## Documentation/devicetree/bindings/display/panel/kingtech,pv04005td25e.txt
```
Kingtech PV04005TD25E MIPI-DSI panel

Required properties:
  - compatible: "kingtech,pv04005td25e"
  - reg: the virtual channel number of a DSI peripheral
  - reset-gpios: The reset GPIO pin

Optional properties:
  - backlight: phandle to the backlight used

Example:

panel@0 {
	compatible = "kingtech,pv04005td25e";
	reg = <0>;
	backlight = <&lcd_backlight>;
	reset-gpios = <&gpio1 5 GPIO_ACTIVE_LOW>;
};
```

## Documentation/devicetree/bindings/soc/fsl/simple-busfreq-imx8mm.txt
```
Simple busfreq driver for the NXP i.MX8MM SoC:

This driver is a simpler variant of the much more complicated driver from NXP.
Compared to the complicated handling logic of the NXP driver, this driver only
switches to the low busfrequency when requested from userspace.

The current frequency settings are hardcoded to:


Required properties:

- compatible		: "sue,simple-busfreq-imx8mm"
- clocks		: Must contain the list clocks use to control the operation,
			  see the example below for the actual clocks.
- clock-names		: Matching clock names, see example below.

Example:

simple-busfreq {
	compatible = "sue,simple-busfreq-imx8mm";

	clocks = <&clk IMX8MM_CLK_NOC_DIV>,
		 <&clk IMX8MM_CLK_AHB_DIV>,
		 <&clk IMX8MM_CLK_MAIN_AXI_SRC>,
		 <&clk IMX8MM_CLK_24M>,
		 <&clk IMX8MM_SYS_PLL2_333M>;
	clock-names = "noc_div",
		      "ahb_div",
		      "main_axi_src",
		      "osc_24m",
		      "sys_pll2_333m";
};
```

## Documentation/devicetree/bindings/sound/ma12040.txt
```
Infineon MA12040 class-D amplifier

The MA12040 serial control bus communicates through the I2C protocol.
For more product information please see the links below:

https://www.infineon.com/cms/en/product/power/class-d-audio-amplifier-solutions/
integrated-class-d-audio-amplifier-ics/ma12040/

Required properties:

- compatible : "infineon,ma12040"
- reg : I2C slave address

Example:

ma12040_20: ma12040@20 {
	compatible = "infineon,ma12040";
	reg = <0x20>;
};
```

## Documentation/devicetree/bindings/sound/pcm9211.txt
```
PCM9211 audio CODEC

This device supports both I2C and SPI (configured with pin strapping
on the board). The driver is currently implementing I2C only.

Required properties:

  - compatible : "ti,pcm9211"

  - reg : the I2C address of the device for I2C, the chip select
          number for SPI.

Optional properties:

  - clocks : A clock specifier for the clock connected to XTI. While the
    device could work without it, this driver currently relies on it being
    available

  - clock-names : Must specify "xti" to match the requested clock.

  - reset-gpios : GPIO wired to the reset pin, if not supplied a soft-reset is
    used as fallback

  - interrupt-names: Can contain "int0", "int1" or both.

  - interrupts-extended: Specify up to two interrupts that correspond to
    int0 and int1. Currently the functionality of the interrupts is hardcoded,
    int0 is used for detecting SPDIF (DIR) errors and non-PCM data and int1 is
    used for the ADC threshold detection.

  - ti,group-function: An array with size 3 specifying function for pingroups
    A, B and C. Possible values are defined in dt-bindings/sound/pcm9211.h

  - ti,mpio-a-flags-gpio: An array with size 4 specifying flags out or gpio
    mode per pin, when function DIR_FLAGS_GPIO is selected for group a.
    Possible values are defined in dt-bindings/sound/pcm9211.h

  - ti,mpio-b-flags-gpio: An array with size 4 specifying flags out or gpio
    mode per pin, when function DIR_FLAGS_GPIO is selected for group b.
    Possible values are defined in dt-bindings/sound/pcm9211.h

  - ti,mpio-c-flags-gpio: An array with size 4 specifying flags out or gpio
    mode per pin, when function DIR_FLAGS_GPIO is selected for group c.
    Possible values are defined in dt-bindings/sound/pcm9211.h

  - ti,mpio-a-flag: An array with size 4 specifying flag assigned per pin,
    when function DIR_FLAGS_GPIO is selected for group a and pin is set to
    flags mode.
    Possible values are defined in dt-bindings/sound/pcm9211.h

  - ti,mpio-b-flag: An array with size 4 specifying flag assigned per pin,
    when function DIR_FLAGS_GPIO is selected for group b and pin is set to
    flags mode.
    Possible values are defined in dt-bindings/sound/pcm9211.h

  - ti,mpio-c-flag: An array with size 4 specifying flag assigned per pin,
    when function DIR_FLAGS_GPIO is selected for group c and pin is set to
    flags mode.
    Possible values are defined in dt-bindings/sound/pcm9211.h

  - ti,mpo-function: An array with size 2 specifying flag assigned per mpo
    pin.
    Possible values are defined in dt-bindings/sound/pcm9211.h

  - ti,hiz-mask: An array with size 4 specifying the Hi-Z register setting for
    MPIO_A, MPIO_B, MPIO_C and the MAIN_OUT ports respectively.

Examples:

	pcm9211: pcm9211@43 {
		compatible = "ti,pcm9211";
		reg = <0x43>;

		clocks = <&xti_clk>;
		clock-names = "xti";
	};


	pcm9211: pcm9211@43 {
		compatible = "ti,pcm9211";
		reg = <0x43>;

		clocks = <&xti_clk>;
		clock-names = "xti";

		reset-gpios = <&gpio1 0 GPIO_ACTIVE_HIGH>;

		ti,group-function = /bits/ 8
			<PCM9211_MPIO_A_GROUP_BIPHASE_INPUT,
			PCM9211_MPIO_B_GROUP_DIR_FLAGS_GPIO,
			PCM9211_MPIO_C_GROUP_AUXIN1>;
		ti,mpio-b-flags-gpio = /bits/ 8
			<PCM9211_MPIO_DIR_FLAGS,
			PCM9211_MPIO_DIR_FLAGS,
			PCM9211_MPIO_DIR_FLAGS,
			PCM9211_MPIO_DIR_FLAGS>;
		ti,mpio-b-flag = /bits/ 8
			<PCM9211_MPIO_FLAG_INT0,
			PCM9211_MPIO_FLAG_CLKST,
			PCM9211_MPIO_FLAG_CLKST,
			PCM9211_MPIO_FLAG_CLKST>;
	};
```

## arch/arm/configs/stream210_defconfig
```kconfig
CONFIG_SYSVIPC=y
# CONFIG_CROSS_MEMORY_ATTACH is not set
CONFIG_NO_HZ_IDLE=y
CONFIG_HIGH_RES_TIMERS=y
CONFIG_PREEMPT=y
CONFIG_IKCONFIG=y
CONFIG_IKCONFIG_PROC=y
CONFIG_BLK_DEV_INITRD=y
# CONFIG_RD_BZIP2 is not set
# CONFIG_RD_LZMA is not set
# CONFIG_RD_LZO is not set
# CONFIG_RD_LZ4 is not set
CONFIG_CC_OPTIMIZE_FOR_SIZE=y
CONFIG_BASE_FULL=y
CONFIG_SHMEM=y
CONFIG_EMBEDDED=y
# CONFIG_VM_EVENT_COUNTERS is not set
CONFIG_ARCH_AMEBASMART=y
CONFIG_ARM_PSCI=y
CONFIG_HZ_250=y
# CONFIG_ARM_MODULE_PLTS is not set
# CONFIG_ATAGS is not set
CONFIG_CPU_FREQ_GOV_POWERSAVE=y
CONFIG_CPU_FREQ_GOV_USERSPACE=y
CONFIG_CPU_FREQ_GOV_ONDEMAND=y
CONFIG_ARM_CRYPTO=y
CONFIG_CRYPTO_SHA1_ARM=y
CONFIG_CRYPTO_SHA256_ARM=y
CONFIG_CRYPTO_SHA512_ARM=y
CONFIG_CRYPTO_AES_ARM=y
CONFIG_MODULES=y
CONFIG_MODULE_UNLOAD=y
# CONFIG_COREDUMP is not set
# CONFIG_COMPACTION is not set
CONFIG_CMA=y
CONFIG_CMA_DEBUG=y
CONFIG_NET=y
CONFIG_PACKET=y
CONFIG_UNIX=y
CONFIG_INET=y
CONFIG_IP_MULTICAST=y
CONFIG_IP_PNP=y
CONFIG_IP_PNP_DHCP=y
# CONFIG_INET_DIAG is not set
# CONFIG_IPV6_SIT is not set
CONFIG_IPV6_SUBTREES=y
CONFIG_IPV6_MROUTE=y
CONFIG_IPV6_SEG6_LWTUNNEL=y
CONFIG_NETFILTER=y
# CONFIG_NETFILTER_INGRESS is not set
CONFIG_NF_CONNTRACK=y
CONFIG_NETFILTER_XT_TARGET_LOG=y
CONFIG_NETFILTER_XT_MATCH_COMMENT=y
CONFIG_NETFILTER_XT_MATCH_CONNTRACK=y
CONFIG_NETFILTER_XT_MATCH_MULTIPORT=y
CONFIG_IP_NF_IPTABLES=y
CONFIG_IP_NF_FILTER=y
CONFIG_IP_NF_TARGET_REJECT=y
CONFIG_IP6_NF_IPTABLES=y
CONFIG_IP6_NF_FILTER=y
CONFIG_IP6_NF_TARGET_REJECT=y
CONFIG_BPF_JIT=y
CONFIG_BT=y
CONFIG_BT_HIDP=y
CONFIG_BT_HCIUART=y
CONFIG_BT_HCIUART_H4=y
CONFIG_CFG80211=y
CONFIG_RFKILL=y
# CONFIG_LWTUNNEL_BPF is not set
CONFIG_UEVENT_HELPER=y
CONFIG_UEVENT_HELPER_PATH="/sbin/mdev"
CONFIG_DEVTMPFS=y
CONFIG_DEVTMPFS_MOUNT=y
CONFIG_MTD=y
CONFIG_MTD_BLOCK=y
CONFIG_MTD_BLOCK2MTD=y
CONFIG_MTD_SPI_NAND=y
CONFIG_MTD_SPI_NOR=y
CONFIG_MTD_UBI=y
CONFIG_MTD_UBI_BLOCK=y
CONFIG_BLK_DEV_LOOP=y
CONFIG_SCSI=y
# CONFIG_SCSI_PROC_FS is not set
CONFIG_BLK_DEV_SD=y
CONFIG_BLK_DEV_SR=y
# CONFIG_SCSI_LOWLEVEL is not set
CONFIG_MD=y
CONFIG_BLK_DEV_DM=y
CONFIG_DM_INIT=y
CONFIG_DM_VERITY=y
CONFIG_NETDEVICES=y
CONFIG_USB_RTL8152=y
CONFIG_USB_USBNET=y
# CONFIG_USB_NET_CDC_NCM is not set
CONFIG_USB_NET_DM9601=y
# CONFIG_USB_NET_NET1080 is not set
# CONFIG_USB_NET_CDC_SUBSET is not set
# CONFIG_USB_NET_ZAURUS is not set
CONFIG_HOSTAP=y
CONFIG_HOSTAP_FIRMWARE=y
CONFIG_HOSTAP_FIRMWARE_NVRAM=y
# CONFIG_INPUT_KEYBOARD is not set
# CONFIG_INPUT_MOUSE is not set
# CONFIG_SERIO is not set
# CONFIG_CONSOLE_TRANSLATIONS is not set
# CONFIG_VT_CONSOLE is not set
CONFIG_HW_RANDOM=y
CONFIG_I2C_GPIO=y
CONFIG_SPI_SPIDEV=y
CONFIG_PINCTRL=y
CONFIG_GPIO_SYSFS=y
# CONFIG_HWMON is not set
CONFIG_REGULATOR=y
CONFIG_REGULATOR_FIXED_VOLTAGE=y
CONFIG_BACKLIGHT_CLASS_DEVICE=y
# CONFIG_BACKLIGHT_GENERIC is not set
CONFIG_BACKLIGHT_GPIO=y
CONFIG_SOUND=y
CONFIG_SND=y
# CONFIG_SND_DRIVERS is not set
# CONFIG_SND_ARM is not set
# CONFIG_SND_SPI is not set
# CONFIG_SND_USB is not set
CONFIG_SND_SOC=y
CONFIG_SND_SOC_REALTEK=y
CONFIG_SND_SOC_RTK_AMEBA=y
CONFIG_HID_BATTERY_STRENGTH=y
CONFIG_HIDRAW=y
CONFIG_USB_HIDDEV=y
CONFIG_USB=y
CONFIG_USB_STORAGE=y
CONFIG_USB_DWC2=y
CONFIG_USB_DWC2_HOST=y
CONFIG_USB_SERIAL=y
CONFIG_USB_SERIAL_FTDI_SIO=y
CONFIG_USB_GADGET=y
CONFIG_USB_CONFIGFS=y
CONFIG_USB_CONFIGFS_MASS_STORAGE=y
CONFIG_LEDS_GPIO=y
CONFIG_DMADEVICES=y
CONFIG_STAGING=y
CONFIG_ASHMEM=y
# CONFIG_ARM_ARCH_TIMER_EVTSTREAM is not set
# CONFIG_IOMMU_SUPPORT is not set
CONFIG_INA2XX_ADC=y
CONFIG_VEML3328=y
CONFIG_ANDROID=y
CONFIG_ANDROID_BINDER_IPC=y
CONFIG_ANDROID_BINDER_DEVICES="binder"
CONFIG_TEE=y
CONFIG_OPTEE=y
CONFIG_RTK_DRIVERS=y
CONFIG_ADC_RTK_AMEBA=y
CONFIG_CAPTOUCH_RTK_AMEBA=y
CONFIG_WIFI_RTK_CFG80211_FULLMAC=y
CONFIG_FULLMAC_RTK_RTL8730E=y
CONFIG_CPUFREQ_RTK_AMEBA=y
CONFIG_CRYPTO_RTK_AMEBA=y
CONFIG_HASH_RTK_AMEBA=y
CONFIG_AES_RTK_AMEBA=y
CONFIG_TOUCHSCREEN_RTK_AMEBA=y
CONFIG_DMAC_RTK_AMEBA=y
CONFIG_DRM_RTK_AMEBA=y
CONFIG_DRM_DSI_RTK_AMEBA=y
CONFIG_AMEBA_PANEL=y
CONFIG_IPC_RTK_AMEBA=y
CONFIG_I2C_RTK_AMEBA=y
CONFIG_LEDC_RTK_WS28XXX=y
CONFIG_MISC_RTK_AMEBA=y
CONFIG_OTP_RTK_AMEBA=y
CONFIG_OTP_IPC_RTK_AMEBA_CDEV=y
CONFIG_RTC_RTK_AMEBA=y
CONFIG_SPIC_RTK_AMEBA_RXI312=y
CONFIG_SPI_RTS_QUADSPI_POLLING=y
CONFIG_SPI_RTK_AMEBA=y
CONFIG_THERMAL_RTK_AMEBA=y
CONFIG_SERIAL_RTK_AMEBA=y
CONFIG_SERIAL_RTK_AMEBA_CONSOLE=y
CONFIG_SERIAL_RTK_AMEBA_GENERIC=y
CONFIG_USB_RTK_AMEBA_USB20PHY=y
CONFIG_WATCHDOG_RTK_AMEBA=y
CONFIG_BT_IOCTL_RTK_AMEBA=y
CONFIG_EXT4_FS=y
CONFIG_FUSE_FS=y
CONFIG_OVERLAY_FS=y
CONFIG_ISO9660_FS=y
CONFIG_JOLIET=y
CONFIG_ZISOFS=y
CONFIG_VFAT_FS=y
CONFIG_TMPFS=y
CONFIG_JFFS2_FS=y
CONFIG_UBIFS_FS=y
CONFIG_SQUASHFS=y
CONFIG_PSTORE=y
# CONFIG_PSTORE_DEFLATE_COMPRESS is not set
CONFIG_PSTORE_RAM=y
CONFIG_NFS_FS=y
CONFIG_ROOT_NFS=y
CONFIG_NLS_CODEPAGE_437=y
CONFIG_NLS_ISO8859_1=y
CONFIG_NLS_UTF8=y
CONFIG_CRYPTO_PCRYPT=y
CONFIG_CRYPTO_USER_API_HASH=y
CONFIG_CRYPTO_USER_API_SKCIPHER=y
CONFIG_CRYPTO_USER_API_RNG=y
# CONFIG_CRYPTO_HW is not set
CONFIG_PRINTK_TIME=y
CONFIG_FRAME_WARN=4096
CONFIG_DEBUG_FS=y
# CONFIG_SCHED_DEBUG is not set
# CONFIG_DEBUG_BUGVERBOSE is not set
CONFIG_RCU_TRACE=y
# CONFIG_FTRACE is not set
```

## arch/arm64/Kconfig.formosa
```kconfig
#
# Realtek Semiconductor Corp.
#
# RLX Linux Kernel Configuration
#
# Tony Wu (tonywu@realtek.com)
# Dec. 07, 2008
#

source "formosa/config.top"
source "formosa/config.soc"

#
# ARM
#
config SHEIPA
	bool
	default y
	select CPU_BIG_ENDIAN if SOC_CPU_EB
	select CPU_LITTLE_ENDIAN if SOC_CPU_EL
	select ARM_GIC
	select CPU_HAS_L2C if SOC_ENABLE_L2C
	select HW_HAS_PCI if SOC_ENABLE_PCI
	select HW_HAS_USB if SOC_ENABLE_USB
	select HAVE_SMP if SOC_ENABLE_SMP
	select SMP if SOC_ENABLE_SMP

#
# CPU
#
config CPU_ARMA53
	bool
	default y if SOC_CPU_ARMA53
	select CPU_V8

config CPU_ARMA57
	bool
	default y if SOC_CPU_ARMA57
	select CPU_V8

config CPU_ARMA57_A53
	bool
	default y if SOC_CPU_ARMA57_A53
	select CPU_V8

config CPU_ARMA75_A55
	bool
	default y if SOC_CPU_ARMA75_A55
	select CPU_V8

#
# CACHE
#
config CPU_HAS_L2C
	bool

#
# BUS
#
config HW_HAS_USB
	bool

config HW_HAS_PCI
        bool
```
