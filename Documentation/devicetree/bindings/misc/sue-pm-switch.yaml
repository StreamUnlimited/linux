## Documentation/devicetree/bindings/misc/sue-pm-switch.yaml
```yaml
# SPDX-License-Identifier: GPL-2.0
%YAML 1.2
---
$id: "http://devicetree.org/schemas/misc/sue-pm-switch.yaml#"
$schema: "http://devicetree.org/meta-schemas/core.yaml#"

title: Simple Suspend/Resume Regulator Toggle

maintainers:
  - Martin Pietryka <martin.pietryka@streamunlimited.com>

description: |
  A simple platform device that enables a regulator on boot and toggles
  it off during suspend/shutdown and back on during resume.

properties:
  compatible:
    const: sue,pm-switch

  vdd-supply:
    description: Regulator that will be enabled at probe and disabled during suspend.
    $ref: /schemas/types.yaml#/definitions/phandle

required:
  - compatible
  - vdd-supply

additionalProperties: false

examples:
  - |
    pm_switch0: pm-switch@0 {
      compatible = "sue,pm-switch";
      vdd-supply = <&usb_eth_power>;
    };
```

## Documentation/devicetree/bindings/sound/stream195x.txt
```
Stream195x ASoC card driver:

This driver is mainly intended to be used on Stream195x (i.MX8) based devices. Generally
the configuration is similar to `simple-card.txt`, however many features like DAMP and
jack detection are not implemented (yet). And some additional properties were added to
accommodate StreamUnlimited use cases.

Required properties:

- compatible				: "sue,stream195x-audio"
- sue-card,name				: User specified sound card name, one string
- clocks				: Must contain clock entries that match up with the "clock-names"
					  property.
- clock-names				: Must contain at least "pll8k" and can contain "pll11k" and "ext_mclk
					  If both "pll8k" and "pll11k" are specified then the I²S clock source
					  will be chosen based on the requested sample rate. E.g. for 48 kHz,
					  the pll8k clock will be used and for 44.1 kHz the pll11k one will
					  be used.
					  An optional "ext_mclk" clock can be specified, whose rate will be set
					  based on the "ext-clk-rates" property below before playback.
					  An optional pair of "pll_bypass" and "pll_bypass_parent" can be provided,
					  the "pll_bypass" clock will be enabled and then re-parented to the
					  "pll_bypass_parent" on probe.
- ext-mclk-rates			: A list of two rates that will be used to set the "ext_mclk" clock.
					  The first rate corresponds to the 44.1 kHz sample-rate family and
					  the second entry to the 48 kHz family.
- sue-card,dai-link			: Container for dai-link level properties and the CPU and CODEC
					  sub-nodes.


Optional properties:

- powerdown-gpios			: General GPIO used to control power pins of DACs, AMPs, etc.


Dai-link subnode properties and subnodes:

Required dai-link subnodes:

- format				: CPU/CODEC common audio format.
					  "i2s", "right_j", "left_j" , "dsp_a" "dsp_b", "ac97", "pdm", "msb", "lsb"
- cpu					: CPU   sub-node
- codec					: CODEC sub-node

Optional dai-link subnode properties:

- frame-master				: Indicates dai-link frame master.  phandle to a cpu or codec subnode.
- bitclock-master			: Indicates dai-link bit clock master.  phandle to a cpu or codec subnode.
- bitclock-inversion			: bool property. Add this if the dai-link uses bit clock inversion.
- frame-inversion			: bool property. Add this if the dai-link uses frame clock inversion.
- continuous-clock			: bool property. Will set the SND_SOC_DAIFMT_CONT flag to not disable clocks.
- mute-gpios				: GPIO generally connected to the mute pin of the respective codec
- dai-tdm-slot-num			: Number of slots in use. (Channels)
- dai-tdm-slot-width			: Width in bits for each slot.

Required CPU/CODEC subnodes properties:
one of:
- sound-dai				: phandle and port of CPU/CODEC
- use-dummy-codec			: specify that a dummy codec should be used; applies to CODEC subnodes

NOTE: Only one of the above properties is required for CODEC subnodes, if both
are specified and sound-dai points to a valid device, it takes precedence over
the dummy codec.


Example:

sound-pcm {
	compatible = "sue,stream195x-audio";
	sue-card,name = "Stream Audio on i.MX8MM";

	clocks = <&clk IMX8MM_AUDIO_PLL1_OUT>, <&clk IMX8MM_AUDIO_PLL2_OUT>;
	clock-names = "pll8k", "pll11k";

	powerdown-gpios = <&gpio1 6 GPIO_ACTIVE_LOW>;

	sue-card,dai-link@0 {
		format = "i2s";

		continuous-clock;

		frame-master = <&dailink0_cpu>;
		bitclock-master = <&dailink0_cpu>;

		mute-gpios = <&gpio1 4 GPIO_ACTIVE_LOW>;

		dailink0_cpu: cpu {
			sound-dai = <&sai5>;
			dai-tdm-slot-num = <2>;
			dai-tdm-slot-width = <32>;
		};

		dailink0_codec: codec {
			use-dummy-codec;
		};
	};
};
```

## drivers/rtkdrivers/spic/Kconfig
```kconfig
# SPDX-License-Identifier: GPL-2.0-only
#
# SPIC driver configuration
#

config SPIC_RTK_AMEBA_RXI312
	bool "RXI312 SPI controller driver for NAND"
	select SPI
	select SPI_REALTEK_RXI312
	default y
	help
	  This is the driver for the REALTEK RXI312 SPI controller for NAND.

choice
	prompt "RXI312 mode"
	depends on SPIC_RTK_AMEBA_RXI312

config SPI_RTS_QUADSPI_IRQ
	default y
	bool "RXI312 interrupt mode"

config SPI_RTS_QUADSPI_POLLING
	bool "RXI312 polling mode"

endchoice
```
