// SPDX-License-Identifier: (GPL-2.0+ OR MIT)
/*
 * Copyright (C) 2022 StreamUnlimited, Inc. All rights reserved.
 */


/*
 * DT for components located on StreamKit prime carrier board or daughter
 * boards which are not detectable via ADC.
 */

/ {
	sue {
		carrierboard = "streamkitprime";
	};
};
