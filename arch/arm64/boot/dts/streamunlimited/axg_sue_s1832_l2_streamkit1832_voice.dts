// SPDX-License-Identifier: (GPL-2.0+ OR MIT)
/*
 * Copyright (C) 2022 StreamUnlimited, Inc. All rights reserved.
 */

/dts-v1/;

#include "axg_sue_s183x_internal.dtsi"
#include "axg_sue_streamkit1832.dtsi"
#include "axg_sue_l2_streamkit1832_lcd_LQ035NC11.dtsi"
#include "axg_sue_l2_streamkit1832_voice.dtsi"

