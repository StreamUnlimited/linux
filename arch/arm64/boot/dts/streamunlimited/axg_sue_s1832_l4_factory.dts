// SPDX-License-Identifier: (GPL-2.0+ OR MIT)
/*
 * Copyright (C) 2022 StreamUnlimited, Inc. All rights reserved.
 */

/dts-v1/;

#include "axg_sue_s183x_internal.dtsi"
#include "axg_sue_s183x_internal_override_s1832_l4.dtsi"
#include "axg_sue_s183x_external_factory.dtsi"
#include "axg_sue_factory.dtsi"
