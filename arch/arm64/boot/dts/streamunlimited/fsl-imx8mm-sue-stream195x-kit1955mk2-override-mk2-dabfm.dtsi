/*
 * mk2 overrides for the removable dabfm module.
 */

&sound_dabfm {
	clocks = <&clk IMX8MM_AUDIO_PLL1_OUT>, <&clk IMX8MM_AUDIO_PLL2_OUT>;
	clock-names = "pll8k", "pll11k";

	sue-card,dai-link@2 {
		frame-master = <&dailink2_cpu>;
		bitclock-master = <&dailink2_cpu>;
	};
};

&sai6 {
	assigned-clocks = <&clk IMX8MM_CLK_SAI6>;
	assigned-clock-parents = <&clk IMX8MM_AUDIO_PLL1_OUT>;
	assigned-clock-rates = <24576000>;

	/* This only adds the pll8k and the pll11k clock to the list */
	clocks = <&clk IMX8MM_CLK_SAI6_IPG>, <&clk IMX8MM_CLK_DUMMY>,
		 <&clk IMX8MM_CLK_SAI6_ROOT>, <&clk IMX8MM_CLK_DUMMY>,
		 <&clk IMX8MM_CLK_DUMMY>,
		 <&clk IMX8MM_AUDIO_PLL1_OUT>, <&clk IMX8MM_AUDIO_PLL2_OUT>;
	clock-names = "bus", "mclk0",
				  "mclk1", "mclk2",
				  "mclk3",
				  "pll8k", "pll11k";

	status = "okay";
};
